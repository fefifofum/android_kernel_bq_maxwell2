## arch/arm/mach-rk30/Kconfig
```kconfig
if ARCH_RK30

choice
	prompt "RK30xx Board Type"
	default MACH_RK30_SDK

config MACH_RK30_SDK
	bool "RK30 SDK board"
	
config MACH_RK30_DS975
	bool "RK30 DS975 board"

config MACH_RK3066_SDK
	bool "RK3066 SDK board"

config MACH_RK30_DS1001B
        bool "RK30 DS1001B board"

config MACH_RK30_PHONE_PAD
        bool "RK30 smart phone pad board"
        
config MACH_RK30_PHONE
	bool "RK30 smart phone board"

config MACH_RK30_PHONE_LOQUAT
	bool "RK30 smart phone loquat board"

config MACH_RK30_PHONE_A22
        bool "RK30 smart phone a22 board"
	
endchoice

menuconfig PROJECT_TYPE
	bool "RK30xx Projectg Type"
	
if PROJECT_TYPE
menuconfig BQ_C8005
	bool "BQ C8005 Project"

menuconfig BQ_D8002
	bool "BQ D8002 Project"

menuconfig BQ_D7007
	bool "BQ D7007 Project"

menuconfig BQ_D7006
	bool "BQ D7006 Project"

menuconfig BQ_C1016
	bool "BQ C1016 Project"

menuconfig BQ_D8005
	bool "BQ D8005 Project"

menuconfig BQ_D7008
	bool "BQ D8005 Project"

menuconfig BQ_D1002
	bool "BQ D1002 Project"

menuconfig BQ_C7022
	bool "BQ C7022 Project"

menuconfig BQ_C7011
	bool "BQ C7011 Project"

menuconfig BQ_D9001
	bool "BQ D9001 Project"

menuconfig BQ_C7019A
	bool "BQ C7019A Project"

menuconfig BQ_C7019B
	bool "BQ C7019B Project"
endif

choice
	prompt "CE CONFIG"
	default UNPASS_CE

config PASS_CE
	bool "CODEC HEADSET PASS CE"

config UNPASS_CE
	bool "CODEC HEADSET UNPASS CE"
endchoice

choice
	prompt "HEADSET CE CONFIG"
	default UN_HEADSET_PASS_CE

config HEADSET_PASS_CE
	bool "CODEC RT5631 HEADSET PASS CE"

config UN_HEADSET_PASS_CE
	bool "CODEC RT5631 HEADSET UNPASS CE"
endchoice

choice
	prompt "RK30xx GPU Type"
	default GPU_SUPPORT_400M

config GPU_SUPPORT_400M
	bool "gpu  support  400M"

config GPU_SUPPORT_266M
	bool "gpu  support  266M"

endchoice
endif
```
